## main/Kconfig.projbuild
```kconfig
menu "Traffic Light Settings"

# Wifi configuration -----------------------------------------------------------

config WIFI_SSID
    string "WiFi SSID"

config WIFI_PASSWORD
    string "WiFi Password"

endmenu
```
